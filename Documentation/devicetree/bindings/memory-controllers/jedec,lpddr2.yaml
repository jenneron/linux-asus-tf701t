## Documentation/devicetree/bindings/memory-controllers/jedec,lpddr2.yaml
```yaml
# SPDX-License-Identifier: (GPL-2.0-only OR BSD-2-Clause)
%YAML 1.2
---
$id: http://devicetree.org/schemas/memory-controllers/jedec,lpddr2.yaml#
$schema: http://devicetree.org/meta-schemas/core.yaml#

title: JEDEC LPDDR2 SDRAM

maintainers:
  - Krzysztof Kozlowski <krzk@kernel.org>

properties:
  jedec,lpddr2-manufacturer-id:
    $ref: /schemas/types.yaml#/definitions/uint32
    maximum: 255
    description: |
      Unique manufacturer ID of SDRAM chip. See MR5 description in JESD209-2.

  jedec,lpddr2-revision-id1:
    $ref: /schemas/types.yaml#/definitions/uint32
    maximum: 255
    description: |
      Revision 1 value of SDRAM chip.
      See MR6 description in chip vendor specification.

  jedec,lpddr2-revision-id2:
    $ref: /schemas/types.yaml#/definitions/uint32
    maximum: 255
    description: |
      Revision 2 value of SDRAM chip.
      See MR7 description in chip vendor specification.

  jedec,lpddr2-density-mbits:
    $ref: /schemas/types.yaml#/definitions/uint32
    description: |
      Density in megabits of SDRAM chip. See MR8 description in JESD209-2.
    enum:
      - 64
      - 128
      - 256
      - 512
      - 1024
      - 2048
      - 4096
      - 8192
      - 16384
      - 32768

  jedec,lpddr2-io-width-bits:
    $ref: /schemas/types.yaml#/definitions/uint32
    description: |
      IO bus width in bits of SDRAM chip. See MR8 description in JESD209-2.
    enum:
      - 32
      - 16
      - 8

  jedec,lpddr2-type:
    $ref: /schemas/types.yaml#/definitions/uint32
    description: |
      LPDDR type which corresponds to a number of words SDRAM pre-fetches
      per column request. See MR8 description in JESD209-2.
    enum:
      - 0 # S4 (4 words prefetch architecture)
      - 1 # S2 (2 words prefetch architecture)
      - 2 # NVM (Non-volatile memory)

additionalProperties: false

examples:
  - |
    #include <dt-bindings/memory/lpddr2.h>

    lpddr2 {
        jedec,lpddr2-manufacturer-id = <LPDDR2_MANID_ELPIDA>;
        jedec,lpddr2-revision-id1 = <1>;
        jedec,lpddr2-density-mbits = <2048>;
        jedec,lpddr2-io-width-bits = <16>;
        jedec,lpddr2-type = <LPDDR2_TYPE_S4>;
    };
```
